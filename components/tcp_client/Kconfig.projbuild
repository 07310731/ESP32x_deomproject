## components/tcp_server/Kconfig.projbuild
```kconfig
menu "TCP Server"
    depends on SERVICE_TCP_SERVER_ENABLE

    config TCP_SERVER_PORT
        int "Listen port"
        default 8888
        range 1 65535

    config TCP_SERVER_MAX_CLIENTS
        int "Max concurrent clients"
        default 2
        range 1 4
        help
            同步连接数上限。多于此数的连接请求会被直接 close。
            每个 client 对应一个独立 handler 任务 + 1KB echo 缓冲区，
            所以这项也决定了 BSS 占用（max_clients × 1KB）。

    config TCP_SERVER_ECHO_BUF
        int "Per-client echo buffer (bytes)"
        default 1024
        range 64 8192
        help
            echo 模式每个 client handler 独立一份的接收/回送缓冲区。

    config TCP_SERVER_ACCEPT_POLL_MS
        int "accept() wakeup period (ms)"
        default 200
        range 50 2000
        help
            listen socket 的轮询周期。短一些更及时接新连接，
            长一些省电。新连接不太频繁的场景 200ms 完全够用。

    config TCP_SERVER_IDLE_TIMEOUT_MS
        int "Idle disconnect timeout (ms, 0 = disable)"
        default 30000
        range 0 600000
        help
            客户端在这个时长内没发任何数据就被服务端主动断开。
            0 = 关闭这道检查（只留底层 keepalive）。
            必须 >= 业务允许的最大静默间隔，否则会误杀正常连接。
    # 注：tcp_server 的 TCP keepalive 参数（idle 10s / interval 3s / cnt 3）
    # 仍是组件内部硬编码 —— 要开放需要给 tcp_server_cfg_t 加字段，
    # 改起来要触碰 tcp_server_accept()，属于另一波改动。
endmenu
```

## components/udp/Kconfig.projbuild
```kconfig
menu "UDP"
    depends on SERVICE_UDP_ENABLE

    config UDP_PORT
        int "Bind port"
        default 7777
        range 1 65535

    # 注：UDP 接收缓冲区统一使用 CONFIG_RX_MAX_FRAME（service common 菜单）。
    # UDP payload 上限取决于 MTU（不分片 1472 字节）；通过 IP 分片可更大，
    # 但风险高，所以默认 1024 已经够大多数控制指令。

    config UDP_RECV_TIMEOUT_MS
        int "recvfrom wakeup period (ms)"
        default 1000
        range 100 10000
        help
            recvfrom 阻塞超过这个时长就返回，让 worker 周期性检查
            "网络状态 / IP 是否变了"。

    config UDP_SEND_TIMEOUT_MS
        int "sendto blocking timeout (ms)"
        default 5000
        range 100 60000
endmenu
```
